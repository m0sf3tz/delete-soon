## conf/layer.conf
```bitbake
# We have a conf and classes directory, add to BBPATH
BBPATH .= ":${LAYERDIR}"

# We have recipes-* directories, add to BBFILES
BBFILES += "${LAYERDIR}/recipes-*/*/*.bb \
            ${LAYERDIR}/recipes-*/*/*.bbappend"

BBFILE_COLLECTIONS += "meta-pbes-kernel"
BBFILE_PATTERN_meta-pbes-kernel = "^${LAYERDIR}/"
BBFILE_PRIORITY_meta-pbes-kernel = "6"

LAYERDEPENDS_meta-pbes-kernel = "core"
LAYERSERIES_COMPAT_meta-pbes-kernel = "dunfell"
```
